/*
 * Copyright (c) 2026 Andrew Herbert
 *
 * SPDX-License-Identifier: Apache-2.0
 */

#include "../../../dts/xiao_nrf54l15_nrf54l15_cpuapp_internal_partitions.dtsi"

/ {
	chosen {
		zephyr,code-partition = &boot_partition;
	};
};
